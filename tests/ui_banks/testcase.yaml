## tests/ui_banks/testcase.yaml
```yaml
tests:
  ht.ui_banks:
    tags: ui banks channels settings
    platform_allow: native_sim_64
    integration_platforms:
      - native_sim_64
```

## tests/ui_diagnostic/testcase.yaml
```yaml
tests:
  ht.ui_diagnostic:
    tags: ui diagnostic radio settings
    platform_allow: native_sim_64
    integration_platforms:
      - native_sim_64
```

## tests/ui_home/testcase.yaml
```yaml
tests:
  ht.ui_home:
    tags: ui battery timeout settings
    platform_allow: native_sim_64
    integration_platforms:
      - native_sim_64
```

## tests/ui_lock/testcase.yaml
```yaml
tests:
  ht.ui_lock:
    tags: ui input keypad
    platform_allow: native_sim_64
    integration_platforms:
      - native_sim_64
```

## tests/ui_lock_service/testcase.yaml
```yaml
tests:
  ht.ui_lock_service:
    tags: ui input keypad
    platform_allow: native_sim_64
    integration_platforms:
      - native_sim_64
```

## tests/ui_menu/testcase.yaml
```yaml
tests:
  ht.ui_menu:
    tags: ui battery timeout settings
    platform_allow: native_sim_64
    integration_platforms:
      - native_sim_64
  ht.ui_menu.no_codec:
    tags: ui
    platform_allow: native_sim_64
    integration_platforms:
      - native_sim_64
    extra_configs:
      - CONFIG_HT_M17_MODE=n
      - CONFIG_HT_CODEC2=n
```

## tests/ui_motion/testcase.yaml
```yaml
tests:
  ht.ui_motion:
    tags: ui animation radio settings
    platform_allow: native_sim_64
    integration_platforms:
      - native_sim_64
```

## tests/ui_system/testcase.yaml
```yaml
tests:
  ht.ui_system:
    tags: ui battery power fault
    platform_allow: native_sim_64
    integration_platforms:
      - native_sim_64
```

## tests/wasm_loader/testcase.yaml
```yaml
tests:
  ht.wasm_loader:
    tags: wasm ui radio
    platform_allow: native_sim_64
    integration_platforms:
      - native_sim_64
```

## west.yml
```yaml
# SPDX-License-Identifier: GPL-3.0-or-later
manifest:
  self:
    path: oe3anc-ht
  projects:
  - name: zephyr
    url: https://github.com/zephyrproject-rtos/zephyr
    revision: a4de2eb3d1756c445d2e2ecb72e6d562674c118b
    path: zephyr
    west-commands: scripts/west-commands.yml
  - name: lvgl
    url: https://github.com/OE3ANC/lvgl
    revision: 702997cb1d61aece05fda62c140defd52dd3c36f
    path: modules/lib/gui/lvgl
  - name: codec2
    url: https://github.com/M17-Project/Codec2-mod
    revision: 7c334283794fa6304dc014f12df70afc8393143a
    path: modules/lib/codec2-mod
```
