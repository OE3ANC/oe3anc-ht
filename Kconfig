## Kconfig
```kconfig
# SPDX-License-Identifier: GPL-3.0-or-later
mainmenu "OE3ANC HT"
source "Kconfig.zephyr"
```

## boards/arm/c62/Kconfig.board
```kconfig
# SPDX-License-Identifier: GPL-3.0-or-later
config BOARD_C62
    bool "Retevis C62"
    depends on SOC_CSK6
```

## boards/arm/c62/Kconfig.defconfig
```kconfig
# SPDX-License-Identifier: GPL-3.0-or-later
if BOARD_C62
config BOARD
    default "c62"
endif
```

## boards/arm/c62/c62_defconfig
```kconfig
# SPDX-License-Identifier: GPL-3.0-or-later
CONFIG_BOARD_C62=y
CONFIG_SOC_CSK6=y
CONFIG_SYS_CLOCK_HW_CYCLES_PER_SEC=300000000
CONFIG_SERIAL=y
CONFIG_CONSOLE=y
CONFIG_UART_CONSOLE=y
CONFIG_UART_CSK6=y
CONFIG_SPI=y
CONFIG_SPI_CSK6=y
CONFIG_GPIO=y
CONFIG_PINCTRL=y
CONFIG_DISPLAY=y
CONFIG_ST7735R=y
CONFIG_PWM=y
CONFIG_PWM_CSK6=y
CONFIG_ADC=y
CONFIG_ADC_CSK6=y
CONFIG_FLASH_LOAD_SIZE=0x100000
```

## dts/bindings/ht,c62-battery.yaml
```yaml
# SPDX-License-Identifier: GPL-3.0-or-later
description: C62 charger and switched battery ADC inputs
compatible: "ht,c62-battery"
include: base.yaml
properties:
  io-channels:
    required: true
  io-channel-names:
    required: true
```

## dts/bindings/ht,c62-companion.yaml
```yaml
# SPDX-License-Identifier: GPL-3.0-or-later
description: C62 companion UART pin ownership
compatible: "ht,c62-companion"
include: [base.yaml, pinctrl-device.yaml]
```

## dts/bindings/ht/ht,bk4819.yaml
```yaml
description: C62 BK4819 three-wire transceiver control
compatible: "ht,bk4819"
include: base.yaml
properties:
  clock-gpios:
    type: phandle-array
    required: true
  data-gpios:
    type: phandle-array
    required: true
  select-gpios:
    type: phandle-array
    required: true
```

## modules/Kconfig
```kconfig
# SPDX-License-Identifier: GPL-3.0-or-later
config HT_CSK_SPI
    bool "C62 SPI driver with error cancellation"
    depends on BOARD_C62
    select SPI
    select DMA
    default y

config HT_CSK_GPIO
    bool "CSK GPIO driver with atomic shared-port updates"
    depends on BOARD_C62
    select GPIO
    default y

config HT_CSK_ADC
    bool "C62 ADC driver with bounded polling and pinmux recovery"
    depends on BOARD_C62
    select ADC
    default y

config HT_BK4819
    bool "BK4819 transceiver driver"
    depends on BOARD_C62 || ZTEST
    default y if BOARD_C62

config HT_BATTERY
    bool "Cached battery and power-switch telemetry"
    depends on CPP && (HT_CSK_ADC || HT_EMULATOR)
    default y if !ZTEST

config HT_AUDIO
    bool "Bounded audio transport"
    depends on BOARD_C62 || ZTEST
    default y if BOARD_C62

config HT_POWER
    bool "Battery switch startup gate and inactive outputs"
    depends on HT_BATTERY && HT_RADIO
    depends on HT_EMULATOR || (BOARD_C62 && HT_C62_RADIO && HT_C62_UI && HT_UI)
    default y if !ZTEST

config HT_LVGL
    bool "LVGL core for the HT UI"
    default y

config HT_EMULATOR
    bool "Simulated radio peripherals"
    depends on BOARD_NATIVE_SIM
    default y

config HT_RADIO
    bool "Radio controller"
    depends on HT_EMULATOR || HT_C62_RADIO
    default y

config HT_C62_RADIO
    bool "C62 radio backend"
    depends on BOARD_C62 || ZTEST
    select HT_BK4819
    select HT_AUDIO
    select HT_FM
    select HT_M17_MODE
    default y if BOARD_C62

config HT_FM
    bool "FM mode"
    default y if HT_RADIO

config HT_M17_PROTOCOL
    bool "M17 voice framing and channel coding"
    depends on CPP
    default y

config HT_CODEC2
    bool "Codec2 3200 voice"
    depends on HT_M17_PROTOCOL
    select SYS_HEAP_RUNTIME_STATS if ZTEST
    default y

config HT_M17_MODULATOR
    bool "M17 48 kHz transmit modulation"
    depends on HT_M17_PROTOCOL
    default y

config HT_M17_DEMODULATOR
    bool "M17 24 kHz receive demodulation"
    depends on HT_M17_PROTOCOL
    default y

config HT_M17_MODE
    bool "M17 voice processing worker"
    depends on HT_AUDIO && CPP
    select HT_M17_PROTOCOL
    select HT_CODEC2
    select HT_M17_MODULATOR
    select HT_M17_DEMODULATOR


config HT_SETTINGS
    bool "Persistent radio settings"
    depends on HT_RADIO && CPP
    select HT_CHANNELS
    select CRC
    default y if BOARD_C62 || HT_EMULATOR

config HT_CHANNELS
    bool "Bounded channel and bank codeplug"
    depends on HT_RADIO && CPP
    select CRC
    default y if HT_SETTINGS

config HT_CODEPLUG_STORAGE
    bool
    depends on HT_SETTINGS && HT_CHANNELS
    default y

config HT_SHUTDOWN_SAVE_BUDGET_MS
    int "Pending-save budget after confirmed radio shutdown (ms)"
    depends on HT_CODEPLUG_STORAGE
    range 50 5000
    default 1000
    help
      Cooperative deadline between synchronous storage calls, not a hard bound
      on an already-running flash erase/write or host fsync. RF stops first.
      Tune using measured full-codeplug and flash-GC timing on the target.

config HT_SETTINGS_NVS
    bool "Zephyr NVS settings backend"
    depends on HT_SETTINGS && (BOARD_C62 || ZTEST)
    select FLASH
    select FLASH_PAGE_LAYOUT
    select FLASH_MAP
    select NVS
    default y if BOARD_C62

config HT_UI
    bool "Basic handheld UI"
    depends on HT_LVGL && HT_RADIO && (HT_EMULATOR || HT_C62_UI)
    default y

config HT_C62_UI
    bool "C62 display and physical controls"
    depends on BOARD_C62 || ZTEST
    default y if BOARD_C62

config HT_RESOURCE_DIAGNOSTICS
    bool "Periodic heap, stack and audio measurements"
    depends on HT_RADIO && HT_UI && HT_CODEC2
    select SYS_HEAP_RUNTIME_STATS
    select THREAD_NAME
    select THREAD_ANALYZER if !ARCH_POSIX
    select PRINTK
    select LOG
    select UART_CONSOLE if BOARD_C62
    select LOG_BACKEND_UART if BOARD_C62
    help
      Development-only UART/log reports every 15 seconds. Enable with
      config/resources.conf; measurements still need a hardware acceptance run.

config HT_COMPANION
    bool "Runtime UART companion mode"
    depends on HT_RADIO && (HT_EMULATOR || (HT_C62_UI && HT_UI) || ZTEST)
    depends on !UART_ASYNC_API
    depends on !BOARD_C62 || (!UART_CONSOLE && !LOG_BACKEND_UART && !PRINTK && !SHELL)
    select UART_INTERRUPT_DRIVEN if BOARD_C62
    select RING_BUFFER if BOARD_C62
    help
      Temporary menu toggle. C62 UART2 RX replaces physical PTT; normal mode
      requires a fresh PTT release before transmitting. Default C62 firmware
      reserves UART2 for protocol bytes. Emulator models ownership
      only. The paired application protocol provides sessions, codeplug/UI
      transfers, virtual keys and a separately leased controller-owned PTT
      source. ZTEST also permits the C62 RF fixture without a display backend.
```

## tests/audio/testcase.yaml
```yaml
tests:
  ht.audio:
    platform_allow: native_sim_64
    integration_platforms:
      - native_sim_64
    tags:
      - audio
      - emulator
```

## tests/battery/testcase.yaml
```yaml
tests:
  ht.battery:
    tags: battery
    platform_allow: native_sim_64
    integration_platforms:
      - native_sim_64
```

## tests/bk4819/testcase.yaml
```yaml
tests:
  ht.bk4819:
    tags: radio
    platform_allow: native_sim_64
    integration_platforms:
      - native_sim_64
```

## tests/c62_adc/testcase.yaml
```yaml
tests:
  ht.c62_adc:
    tags: adc
    platform_allow: native_sim_64
    integration_platforms:
      - native_sim_64
```

## tests/c62_gpio/testcase.yaml
```yaml
tests:
  ht.c62_gpio:
    tags: gpio
    platform_allow: native_sim_64
    integration_platforms:
      - native_sim_64
```

## tests/c62_power_io/testcase.yaml
```yaml
tests:
  ht.c62_power_io:
    tags: power
    platform_allow: native_sim_64
    integration_platforms:
      - native_sim_64
```

## tests/c62_radio/testcase.yaml
```yaml
tests:
  ht.c62_radio:
    platform_allow: native_sim_64
    integration_platforms:
      - native_sim_64
    tags:
      - radio
      - audio
```

## tests/codeplug_storage/testcase.yaml
```yaml
tests:
  ht.codeplug_storage.linux:
    platform_allow: native_sim_64
    integration_platforms:
      - native_sim_64
    tags:
      - settings
      - channels
  ht.codeplug_storage.nvs:
    platform_allow: native_sim_64
    integration_platforms:
      - native_sim_64
    extra_configs:
      - CONFIG_HT_SETTINGS_NVS=y
    tags:
      - settings
      - nvs
```

## tests/linux_sdl/testcase.yaml
```yaml
tests:
  ht.linux_sdl:
    tags: ui linux sdl
    platform_allow: native_sim_64
    integration_platforms:
      - native_sim_64
```

## tests/m17_mode/testcase.yaml
```yaml
tests:
  ht.m17.mode:
    platform_allow: native_sim_64
    integration_platforms:
      - native_sim_64
    tags:
      - m17
      - audio
```

## tests/modem_service/testcase.yaml
```yaml
tests:
  ht.modem_service:
    platform_allow: native_sim_64
    integration_platforms:
      - native_sim_64
    tags:
      - modem
      - radio
```

## tests/settings/testcase.yaml
```yaml
tests:
  ht.settings.linux:
    platform_allow: native_sim_64
    integration_platforms:
      - native_sim_64
    tags:
      - settings
      - channels
  ht.settings.nvs:
    platform_allow: native_sim_64
    integration_platforms:
      - native_sim_64
    extra_configs:
      - CONFIG_HT_SETTINGS_NVS=y
    tags:
      - settings
      - nvs
```

## tests/ui_appearance/testcase.yaml
```yaml
tests:
  ht.ui_appearance:
    tags: ui settings
    platform_allow: native_sim_64
    integration_platforms:
      - native_sim_64
```

## tests/ui_backlight/testcase.yaml
```yaml
tests:
  ht.ui_backlight:
    tags: ui backlight settings
    platform_allow: native_sim_64
    integration_platforms:
      - native_sim_64
```

## tests/ui_backlight_service/testcase.yaml
```yaml
tests:
  ht.ui_backlight_service:
    tags: ui backlight integration
    platform_allow: native_sim_64
    integration_platforms:
      - native_sim_64
```
